## boards/shields/CG40s/Kconfig.defconfig
```kconfig
if SHIELD_CG40s_DONGLE

config ZMK_KEYBOARD_NAME
    default "CG40s Dongle"

config ZMK_SPLIT_BLE_ROLE_CENTRAL
	default y
	
config ZMK_USB
	default y
endif

if SHIELD_CG40s_LEFT || SHIELD_CG40s_RIGHT || SHIELD_CG40s_DONGLE

config ZMK_SPLIT
	default y

config ZMK_BLE
	default y
	

endif
```

## boards/shields/CG40s/Kconfig.shield
```kconfig
config SHIELD_CG40s_LEFT
    def_bool $(shields_list_contains,CG40s_left)

config SHIELD_CG40s_RIGHT
    def_bool $(shields_list_contains,CG40s_right)

config SHIELD_CG40s_DONGLE
    def_bool $(shields_list_contains,CG40s_dongle)
```
